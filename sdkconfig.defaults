## sdkconfig.defaults
```kconfig
CONFIG_AUTOSTART_ARDUINO=y
CONFIG_FREERTOS_HZ=1000

#Logs
#CONFIG_BOOTLOADER_LOG_LEVEL_ERROR=y
#CONFIG_LOG_DEFAULT_LEVEL_ERROR=y

CONFIG_IDF_EXPERIMENTAL_FEATURES=y

# Serial flasher config
CONFIG_ESPTOOLPY_FLASHFREQ_120M=y
CONFIG_ESPTOOLPY_FLASHSIZE_16MB=y

# Compiler options
CONFIG_COMPILER_OPTIMIZATION_PERF=y

# PSRAM
CONFIG_SPIRAM=y
CONFIG_SPIRAM_MODE_OCT=y
CONFIG_SPIRAM_SPEED_120M=y

# ESP System Settings
CONFIG_ESP_DEFAULT_CPU_FREQ_MHZ_240=y
```
